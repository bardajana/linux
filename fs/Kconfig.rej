## fs/Kconfig.rej
```kconfig
--- fs/Kconfig
+++ fs/Kconfig
@@ -208,6 +208,7 @@
 source "fs/sysv/Kconfig"
 source "fs/ufs/Kconfig"
 source "fs/exofs/Kconfig"
+source "fs/aufs/Kconfig"
 
 endif # MISC_FILESYSTEMS
 
```
